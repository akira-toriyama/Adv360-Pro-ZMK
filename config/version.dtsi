#define VERSION_MACRO
macro_ver: macro_ver {
compatible = "zmk,behavior-macro";
display-name = "Version Macro";
#binding-cells = <0>;
bindings = <&kp N2>, <&kp N0>, <&kp N2>, <&kp N5>, <&kp N0>, <&kp N2>, <&kp N0>, <&kp N7>, <&kp MINUS>, <&kp M>, <&kp A>, <&kp I>, <&kp N>, <&kp MINUS>, <&kp N7>, <&kp D>, <&kp N2>, <&kp D>, <&kp N1>, <&kp N8>, <&kp N0>, <&kp MINUS>, <&kp C>, <&kp L>, <&kp I>, <&kp Q>, <&kp U>, <&kp E>, <&kp RET>;
};
